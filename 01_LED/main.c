#include <reg52.h>
#include <intrins.h>
#define uchar unsigned char
#define uint unsigned int
sbit HC138_A = P2^5;	// 74HC138数据输入端 A
sbit HC138_B = P2^6;	// 74HC138数据输入端 B
sbit HC138_C = P2^7;	// 74HC138数据输入端 C

/**********************************************************
*  函数名称：100毫秒延时函数(11.0592MHz)
*  日期：2019-11-29
*  姓名：ZhangHJ
*  说明：由STC-ISP软件自动生成
***********************************************************/
void Delay100ms()		//@11.0592MHz
{
	unsigned char i, j, k;
	_nop_();
	_nop_();
	i = 5;
	j = 52;
	k = 195;
	do
	{
		do
		{
			while (--k);
		} while (--j);
	} while (--i);
}


/**********************************************************
*  函数名称：系统初始化函数
*  日期：2019-11-29
*  姓名：ZhangHJ
*  说明：用于关闭继电器和蜂鸣器
*		 1. 74HC138输入101 --> Y5=0 --> CY5=1
*		 2. 74HC573的输入经过ULN2003取反后,关闭继电器和蜂鸣器
***********************************************************/
void System_Init()
{
	HC138_C = 1;
	HC138_B = 0;
	HC138_A = 1;	// Y5=0 --> CY5 =1
	P0 = 0x00;		// 关闭继电器和蜂鸣器
}


/**********************************************************
*  函数名称：LED初始化函数
*  日期：2019-11-29
*  姓名：ZhangHJ
*  说明：用于配置LED
*		 1. 74HC138输入100 --> Y4=0 --> CY4=1
*		 2. WR或非Y4 --> CY4
***********************************************************/
void LED_config()
{
	HC138_C = 1;
	HC138_B = 0;
	HC138_A = 0;
	WR = 0;
}


// 主函数功能：关闭蜂鸣器和继电器,LED循环点亮
void main()
{
	System_Init();
	LED_config();
	P0 = 0xFE;
	while(1)
	{
		Delay100ms();
		P0 = _crol_(P0, 1);
	}
}